/* Provide the SPI bus label that the nice_view shield requires. */
nice_view_spi: &spi0 {
  compatible = "nordic,nrf-spim";
  pinctrl-0 = <&spi0_default>;
  pinctrl-1 = <&spi0_sleep>;
  pinctrl-names = "default", "sleep";

  /* nice!view default CS pin is D1 / P0.06 */
  cs-gpios = <&gpio0 6 GPIO_ACTIVE_HIGH>;
};
